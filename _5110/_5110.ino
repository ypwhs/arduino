//端口定义
 
int LCD_CE=5;
int LCD_RST=6;
int SCLK=2;
int SDIN=3;
int LCD_DC=4;
int BL=9;
//****************************定义ASCII字符**********************//
 
/********************************** 
6 x 8 font 
1 pixel space at left and bottom 
index = ASCII - 32 
***********************************/ 
const unsigned char font6x8[][6] = 
{ 
    { 0x00, 0x00, 0x00, 0x00, 0x00, 0x00 },   // sp 
    { 0x00, 0x00, 0x00, 0x2f, 0x00, 0x00 },   // ! 
    { 0x00, 0x00, 0x07, 0x00, 0x07, 0x00 },   // " 
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    { 0x14, 0x14, 0x14, 0x14, 0x14, 0x14 }    // horiz lines 
};
static const byte hanzi12x16[][24]={
{0x01,0x01,0x01,0x01,0x01,0x01,0x01,0x01,0x01,0x01,0x01,0x01,0x02,0x04,0x08,0x10,0x20,0x40,0x80}
,{0xFF}
,{0x00,0x02,0x02,0x02,0x02,0xFE,0x02,0x02,0x02,0x02,0x00,0x00,0x08,0x08,0x08,0x08,
0x08,0x0F,0x08,0x08,0x08,0x08,0x08,0x00}//82 工
,{0x10,0x10,0xFF,0x10,0x04,0x04,0xFD,0x26,0x24,0x24,0xE4,0x00,0x04,0x04,0x03,0x02,
0x08,0x06,0x01,0x00,0x08,0x08,0x07,0x00} //83 坊 
};
 
/************************LCD初始化函数********************************/  
void LCD_init(void) 
{ 
    //先设置为输出 
     pinMode(SCLK,OUTPUT); 
     pinMode(SDIN,OUTPUT);
     pinMode(LCD_DC,OUTPUT); 
     pinMode(LCD_CE,OUTPUT);
     pinMode(LCD_RST,OUTPUT);
 
    // 产生一个让LCD复位的低电平脉冲 
     digitalWrite( LCD_RST, LOW); 
 
     delayMicroseconds(1);
     digitalWrite( LCD_RST, HIGH); 
 
    // 关闭LCD 
     digitalWrite( LCD_CE, LOW); 
     delayMicroseconds(1);
 
    // 使能LCD 
     digitalWrite( LCD_CE, HIGH); //LCD_CE = 1; 
     delayMicroseconds(1); 
    LCD_write_byte(0x21, 0); // 使用扩展命令设置LCD模式 
    LCD_write_byte(0xc8, 0); // 设置偏置电压 
    LCD_write_byte(0x06, 0); // 温度校正 
    LCD_write_byte(0x13, 0); // 1:48 
    LCD_write_byte(0x20, 0); // 使用基本命令 
    LCD_clear();             // 清屏 
    LCD_write_byte(0x0c, 0); // 设定显示模式，正常显示 
 
    // 关闭LCD 
   digitalWrite( LCD_CE, LOW);  //LCD_CE = 0; 
} 
/************************LCD清屏函数*******************************/ 
void LCD_clear(void) 
{ 
    unsigned int i; 
    LCD_write_byte(0x0c, 0);  
    LCD_write_byte(0x80, 0); 
    for (i=0; i<504; i++) 
      { 
        LCD_write_byte(0, 1); 
      }    
} 
/*************************设置字符位置函数**************************/
void LCD_set_XY(unsigned char X, unsigned char Y) 
{ 
    LCD_write_byte(0x40 | Y, 0);// column 
    LCD_write_byte(0x80 | X, 0);// row 
} 
/*************************ASCII字符显示函数*************************/ 
void LCD_write_char(unsigned char c) 
{ 
    unsigned char line; 
    c -= 32; 
    for (line=0; line<6; line++) 
    { 
        LCD_write_byte(font6x8[c][line], 1); 
    } 
} 
/*******************************************************************/ 
/*------------------------------------------------- 
LCD_write_english_String  : 英文字符串显示函数 
输入参数：*s      ：英文字符串指针； 
          X、Y    : 显示字符串的位置,x 0-83 ,y 0-5 
--------------------------------------------------*/ 
void LCD_write_english_string(unsigned char X,unsigned char Y,char *s) 
{ 
    LCD_set_XY(X,Y); 
    while (*s)  
    { 
     LCD_write_char(*s); 
     s++; 
    } 
} 
/******************************************************************/ 
/*--------------------------------------------- 
LCD_write_byte    : 写数据到LCD 
输入参数：data    ：写入的数据； 
          command ：写数据/命令选择； 
---------------------------------------------*/ 
void LCD_write_byte(unsigned char dat, unsigned char command) 
{ 
    unsigned char i; 
   digitalWrite( LCD_CE, LOW); // 使能LCD_CE = 0 
    if (command == 0) 
    { 
     digitalWrite( LCD_DC, LOW);// 传送命令 LCD_DC = 0; 
    } 
    else 
    { 
      digitalWrite( LCD_DC, HIGH);// 传送数据LCD_DC = 1; 
    } 
 
  for(i=0;i<8;i++) 
  { 
     if(dat&0x80) 
     { 
        digitalWrite( SDIN, HIGH);//SDIN = 1; 
     } 
    else 
    { 
     digitalWrite( SDIN, LOW);//SDIN = 0; 
     } 
   digitalWrite( SCLK, LOW);//SCLK = 0; 
   dat = dat << 1; 
   digitalWrite( SCLK, HIGH);//SCLK = 1; 
  } 
    digitalWrite( LCD_CE, HIGH);//LCD_CE = 1; 
 
} 
/******************************************************************/ 
/*--------------------------------------------- 
void LCD_write_hanzi  : 汉字显示子函数
输入参数：row ：写入汉字列 page ：写入汉字行 row ：写入汉字   ； 
---------------------------------------------*/  
void LCD_write_hanzi(unsigned char row, unsigned char page,unsigned char dd) //row:列 page:页 dd:字符
{
        unsigned char i;          
        LCD_set_XY(row*8, page);// 列，页 
        for(i=0; i<12;i++) 
        {
                LCD_write_byte(hanzi12x16[dd][i],1); 
        }
 
    LCD_set_XY(row*8, page+1);// 列，页 
        for(i=12; i<24;i++) 
        {
                LCD_write_byte(hanzi12x16[dd][i],1);
        }        
}
 
void setup()
{
  LCD_init();//初始化液晶     
  LCD_clear(); 
  delay(10) ;
  analogWrite(9,10);
}
void loop()
{
  LCD_write_hanzi(0,0,0) ;
  LCD_write_hanzi(2,0,1) ;
  LCD_write_hanzi(4,0,2) ;
  LCD_write_hanzi(6,0,3) ;
  delay(1000) ;
}

